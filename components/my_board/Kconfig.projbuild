## components/my_board/Kconfig.projbuild
```kconfig
menu "My Audio Board"

choice CUSTOMER_AUDIO_BOARD
    prompt "My audio board"
    default MY_BOARD_V1_0
    help
        Select an audio board to use with the ESP-ADF

config MY_BOARD_V1_0
    bool "My board v1.0"

endchoice

config BOARD_PA_GAIN
    int "Power amplifier gain"
    default 10
    help
        The gain of the power amplifier on the board.

endmenu
```

## updater/sdkconfig.defaults
```kconfig
CONFIG_PARTITION_TABLE_CUSTOM=y
CONFIG_PARTITION_TABLE_CUSTOM_FILENAME="../partitions.csv"
CONFIG_PARTITION_TABLE_FILENAME="../partitions.csv"
CONFIG_PARTITION_TABLE_OFFSET=0x8000
CONFIG_ESPTOOLPY_FLASHSIZE_16MB=y
CONFIG_ESP_DEFAULT_LOG_LEVEL_INFO=y
CONFIG_FATFS_LFN_HEAP=y  
```
